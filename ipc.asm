; В IPC kordos входят следующие вызовы

; IPC_Send    - посылка сообщения
; IPC_Recv    - получение сообщения
; IPC_SemUp   - Проверка и установка семафора
; IPC_SemDown - Снятие семафора


; Семафоры
; Количество семафоров жёстко задано в коде. никаких вызовов для их создания

; Структура для хранения семафоров
; 1 байт для хранения значения семафора
; 1 байт для хранения максимального значения семафора

.MACRO IPC_SEMUP

IPC_SemUp:                    ; Preconditions: Номер семафора хранится в R16
    CLI
    PUSH ZL                   ; расчищаем регистры для работы
    PUSH ZH
    PUSH R16
    PUSH R17
    
    LSL   R16                 ; умножаем номер семафора на 2
    
    LDIX  Semaphores          ; Загружаем семафор, берём адрес начала области памяти с семафорами и прибавляем смещение из R16 
    ADD   XL  , R16
    LDI   R16 , 0
    ADC   XH  , R16
    
    LD    R16 , X+            ; Значение семафора
    LD    R17 , X             ; максимальное значение семафора
    CP    R16 , R17
    BREQ  TaskBreak           ; Если семафор уже взведён до максимального уровня  то прерываем задачу и отдаём управление ядру
    RJMP  IPC_SemUp           ; После возврата из ядра идём опять в проверку семафора
    INC   R16                 ; Если семафор не равен максимальному уровню то есть меньше его ( не вижу причин для его превышения) то инкрементим его и RETI
   
    SUBI  XL                  ; смещаем адрес в регистре X на 1 байт назад, чтобы он показывал на байт со значением семафора
    LDI   R17, 0
    SBCI  XH , R17
    
    ST    X  , R16            ; сохраняем значение семафора обратно в память
    
    POP R17                   ; Восстанавливаем регистры
    POP R16
    POP ZH
    POP ZL

IPC_SemUpReti:    
    RETI
.ENDM

.MACRO IPC_SEMDOWN
IPC_SemDown:                  ; Preconditions: Номер семафора хранится в R16
    CLI
    PUSH ZL                   ; расчищаем регистры для работы
    PUSH ZH
    PUSH R16
    PUSH R17
    
    LSL   R16                 ; умножаем номер семафора на 2
    
    LDIX  Semaphores          ; Загружаем семафор, берём адрес начала области памяти с семафорами и прибавляем смещение из R16 
    ADD   XL  , R16
    LDI   R16 , 0
    ADC   XH  , R16
    
    LD    R16 , X+            ; Значение семафора
    LD    R17 , X             ; максимальное значение семафора
    CPI   R16 , 0
    BREQ  IPC_SemDownReti     ; Если семафор уже взведён до максимального уровня  то прерываем задачу и отдаём управление ядру
    DEC   R16                 ; Если семафор не равен максимальному уровню то есть меньше его ( не вижу причин для его превышения) то инкрементим его и RETI
    
    SUBI  XL                  ; смещаем адрес в регистре X на 1 байт назад, чтобы он показывал на байт со значением семафора
    LDI   R17, 0
    SBCI  XH , R17
    
    ST    X  , R16            ; сохраняем значение семафора обратно в память
    
    POP R17                   ; Восстанавливаем регистры
    POP R16
    POP ZH
    POP ZL

IPC_SemDownReti:    
    RETI
.ENDM


